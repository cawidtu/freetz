## make/libs/libboost/Config.in
```kconfig
config FREETZ_LIB_libboost_system
	bool "libboost_system (libboost_system.so)"
	default n
	help
		boost system library

config FREETZ_LIB_libboost_program_options
	bool "libboost_program_options (libboost_program_options.so)"
	default n
	help	
		boost program options library
```

## make/libs/libcares/Config.in
```kconfig
config FREETZ_LIB_libcares
	bool "c-ares (libcares.so)"
	default n
	help
		Libcares I do not know
```

## make/libs/libjson-c/Config.in
```kconfig
config FREETZ_LIB_libjson_c
	bool "libjson-c (libjson-c.so)"
	default n
	help
		libjson-c is ...
```

## make/libs/libuv/Config.in
```kconfig
config FREETZ_LIB_libuv
	bool "libuv (libuv.so)"
#	select FREETZ_LIB_libm
	default n
	help
		lbuv is a multi-platform support library with a focus on asynchronous I/O.
```

## make/shadowsocks/Config.in
```kconfig
config FREETZ_PACKAGE_SHADOWSOCKS
	bool "Shadowsocks classic 3.3.1 (binary only)"
	select FREETZ_LIB_libutil
	select FREETZ_LIB_libev
        select FREETZ_LIB_libcrypto
	select FREETZ_LIB_libmbedtls
	select FREETZ_LIB_libmbedcrypto_WITH_CAMELLIA
        select FREETZ_LIB_libmbedcrypto_WITH_CIPHER_CFG
	select FREETZ_LIB_libmbedcrypto_WITH_BLOWFISH
        select FREETZ_LIB_libpcre
	default n
	help
		shadowsocks is a proxy ...
```

## make/simpleobfs/Config.in
```kconfig
config FREETZ_PACKAGE_SIMPLEOBFS
	bool "simpleobfs 486bebd9 (binary only)"
	select FREETZ_LIB_libutil
        select FREETZ_LIB_libcrypto
        select FREETZ_LIB_libssl
        select FREETZ_LIB_libpcre
	select FREETZ_LIB_libev
	select FREETZ_LIB_libsodium
	select FREETZ_LIB_libcares
	default n
	help
		simple-obfs ...
```

## make/trojan/Config.in
```kconfig
comment "Trojan (not available, needs libstdc++ as Standard C++ Library)"
        depends on !FREETZ_STDCXXLIB_USE_GNULIBSTDCXX

config FREETZ_PACKAGE_TROJAN
	depends on FREETZ_STDCXXLIB_USE_GNULIBSTDCXX
	bool "Trojan 1.15.1"
	select FREETZ_LIB_libboost_system
	select FREETZ_LIB_libboost_program_options
        select FREETZ_LIB_libcrypto
	default n
	help
		An unidentifiable mechanism that helps you bypass GFW. https://trojan-gfw.github.io/trojan/
```
